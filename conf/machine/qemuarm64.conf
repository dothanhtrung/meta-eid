## conf/machine/qemuarm64.conf
```bitbake
DEB_HOST_ARCH = "aarch64"

ARCH ?= "aarch64"
CROSS_COMPILE ?= "${@bb.utils.contains('DEB_CROSS', '1', 'aarch64-linux-gnu', '', d)}"
```

## conf/machine/qemumips.conf
```bitbake
DEB_HOST_ARCH = "mips"

ARCH ?= "mips"
CROSS_COMPILE ?= "${@bb.utils.contains('DEB_CROSS', '1', 'mips-linux-gnu-gcc-8' , '', d)}"
```

## conf/machine/qemuppc64le.conf
```bitbake
DEB_HOST_ARCH = "ppc64le"

ARCH ?= "ppc64le"
CROSS_COMPILE ?= "${@bb.utils.contains('DEB_CROSS', '1', 'powerpc64le-linux-gnu-gcc' , '', d)}"
```

## conf/machine/qemux86.conf
```bitbake
DEB_HOST_ARCH = "i386"

ARCH ?= "x86"
CROSS_COMPILE ?= "${@bb.utils.contains('DEB_CROSS', '1', 'i386-linux-gnu', '', d)}"
```
